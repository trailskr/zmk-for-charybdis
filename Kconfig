## Kconfig
```kconfig
DT_COMPAT_ZMK_BEHAVIOR_RUEN := zmk,behavior-ruen

config ZMK_BEHAVIOR_RUEN
	bool
	default $(dt_compat_enabled,$(DT_COMPAT_ZMK_BEHAVIOR_RUEN))

if ZMK_BEHAVIOR_RUEN

config ZMK_RUEN_TAP_MS
	int "RuEn key tap duration (ms)"
	default 30

config ZMK_RUEN_WAIT_MS
	int "RuEn wait after a tap (ms)"
	default 30

config ZMK_RUEN_SWITCH_WAIT_MS
	int "Wait after sending a layout-switch combo (ms)"
	default 50

config ZMK_RUEN_REVERT_MS
	int "Delay before reverting to Russian after an English-only symbol (ms)"
	default 500

endif
```

## config/west.yml
```yaml
manifest:
  remotes:
    - name: zmkfirmware
      url-base: https://github.com/zettaface
    - name: DoctorWangWang
      url-base: https://github.com/DoctorWangWang
    - name: zettaface
      url-base: https://github.com/zettaface
  projects:
    - name: zmk
      remote: zmkfirmware
      revision: v0.3
      import: app/west.yml
    - name: zmk-pmw3610-driver
      remote: DoctorWangWang
      revision: main
    - name: zmk-input-processor-keybind
      remote: zettaface
      revision: main
      
  self:
    path: config
```

## dts/bindings/behaviors/zmk,behavior-ruen.yaml
```yaml
# Copyright (c) 2026
# SPDX-License-Identifier: MIT

description: Ergohaven-style RuEn layout-aware key

compatible: "zmk,behavior-ruen"

include: one_param.yaml

properties:
  toggle-key:
    type: int
    default: 0
    description: "Combo that toggles OS layout in default mode (Win+Space if unset)."

  mac-toggle-key:
    type: int
    default: 0
    description: "Combo that toggles OS layout in Mac mode (Ctrl+Space if unset)."

  en-key:
    type: int
    default: 0
    description: "Combo that selects English in M1M2 mode (Ctrl+Shift+1 if unset)."

  ru-key:
    type: int
    default: 0
    description: "Combo that selects Russian in M1M2 mode (Ctrl+Shift+2 if unset)."

  tapping-term-ms:
    type: int
    default: 200
    description: "Hold threshold for RuEn Mod (toggle on tap, momentary on hold)."

  default-mode:
    type: int
    default: 0
    description: "0 = toggle combo (Win+Space), 1 = dedicated EN/RU combos (M1M2)."
```
